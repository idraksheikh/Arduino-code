int i,j,k;
int pina[8]={0,1,2,3,4,5,6};
int pinb[8]={7,8,9,10,11,12,13};

int a[10][7]={
  {1,1,1,1,1,1,0},
  {0,1,1,0,0,0,0},
  {1,1,0,1,1,0,1},
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  {1,1,1,1,0,1,1},
  };

 int b[10][7]={
  {1,1,1,1,1,1,0},
  {0,1,1,0,0,0,0},
  {1,1,0,1,1,0,1},
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  {1,1,1,1,0,1,1},
  };

void setup() {
for(i=0;i<7;i++)
{
  pinMode(pina[i],OUTPUT);
digitalWrite(pina[i],0);
pinMode(pinb[i],OUTPUT);
digitalWrite(pinb[i],0);



}
}

void loop() {

for(k=0;k<10;k++)
{
    

        
          
        for(j=0;j<7;j++)
          {
          
          digitalWrite(pina[j],a[k][j]);
          }
          
        
  

        for(i=0;i<10;i++)
        {
          
        for(j=0;j<7;j++)
          {
          
          digitalWrite(pinb[j],a[i][j]);
          }
          delay(200);
        }
    }
}
